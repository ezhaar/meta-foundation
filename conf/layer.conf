## conf/layer.conf
```bitbake
# We have a conf and classes directory, add to BBPATH
BBPATH .= ":${LAYERDIR}"

# We have recipes-* directories, add to BBFILES
BBFILES += "${LAYERDIR}/recipes-*/*/*.bb \
            ${LAYERDIR}/recipes-*/*/*.bbappend"

BBFILE_COLLECTIONS += "meta-izhar"
BBFILE_PATTERN_meta-izhar = "^${LAYERDIR}/"
BBFILE_PRIORITY_meta-izhar = "6"

LAYERDEPENDS_meta-izhar = "core"
LAYERSERIES_COMPAT_meta-izhar = "kirkstone"
```
